# file: 10_INPUT_Capture_PWM.ioc
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Mcu.Family=STM32F4
Mcu.Name=STM32F429I(E-G)Tx
Mcu.Package=LQFP176
NVIC.PriorityGroup=NVIC_PRIORITYGROUP_4
NVIC.TIM4_IRQn=true\:0\:0\:false\:false\:true\:true\:true
PA13.Mode=Trace_Asynchronous_SW
PA13.Signal=SYS_JTMS-SWDIO
PA14.Mode=Trace_Asynchronous_SW
PA14.Signal=SYS_JTCK-SWCLK
PB3.Mode=Trace_Asynchronous_SW
PB3.Signal=SYS_JTDO-SWO
PB6.GPIO_ModeDefaultPP=GPIO_MODE_AF_OD
PB6.GPIO_PuPd=GPIO_PULLDOWN
PB6.GPIO_Speed=GPIO_SPEED_FREQ_HIGH
PB6.Signal=S_TIM4_CH1
PC14/OSC32_IN.Mode=LSE-External-Oscillator
PC14/OSC32_IN.Signal=RCC_OSC32_IN
PC15/OSC32_OUT.Mode=LSE-External-Oscillator
PC15/OSC32_OUT.Signal=RCC_OSC32_OUT
PH0/OSC_IN.Mode=HSE-External-Oscillator
PH0/OSC_IN.Signal=RCC_OSC_IN
PH1/OSC_OUT.Mode=HSE-External-Oscillator
PH1/OSC_OUT.Signal=RCC_OSC_OUT
ProjectManager.HeapSize=0x200
ProjectManager.StackSize=0x400
ProjectManager.TargetToolchain=STM32CubeIDE
RCC.48MHZClocksFreq_Value=90000000
RCC.AHBFreq_Value=180000000
RCC.APB1CLKDivider=RCC_HCLK_DIV4
RCC.APB1Freq_Value=45000000
RCC.APB1TimFreq_Value=90000000
RCC.APB2CLKDivider=RCC_HCLK_DIV2
RCC.APB2Freq_Value=90000000
RCC.APB2TimFreq_Value=180000000
RCC.CortexFreq_Value=180000000
RCC.HCLKFreq_Value=180000000
RCC.HSE_VALUE=25000000
RCC.HSI_VALUE=16000000
RCC.PLLM=15
RCC.PLLN=216
RCC.PLLSourceVirtual=RCC_PLLSOURCE_HSE
RCC.SYSCLKFreq_VALUE=180000000
RCC.SYSCLKSource=RCC_SYSCLKSOURCE_PLLCLK
RCC.VCOOutputFreq_Value=360000000
SH.S_TIM4_CH1.0=TIM4_CH1
SH.S_TIM4_CH1.1=TIM4_CH1,PWM_Input_1
TIM4.Period=0xffff-1
VP_TIM4_VS_ClockSourceINT.Mode=Internal
board=custom

// file: Src/main.c
/* USER CODE BEGIN Header */
/**
  ******************************************************************************
  * @file           : main.c
  * @brief          : Main program body
  ******************************************************************************
  * @attention
  *
  * <h2><center>&copy; Copyright (c) 2019 STMicroelectronics.
  * All rights reserved.</center></h2>
  *
  * This software component is licensed by ST under BSD 3-Clause license,
  * the "License"; You may not use this file except in compliance with the
  * License. You may obtain a copy of the License at:
  *                        opensource.org/licenses/BSD-3-Clause
  *
  ******************************************************************************
  */
/* USER CODE END Header */

#include "main.h"
#include "tim.h"
#include "gpio.h"

/* USER CODE BEGIN Includes */
#include <stdio.h>
/* USER CODE END Includes */

/* USER CODE BEGIN PM */
#define TIM_CLOCKS 90000000
/* USER CODE END PM */

/* USER CODE BEGIN PV */
volatile uint32_t IC_Value_1 = 0;
volatile uint32_t IC_Value_2 = 0;
uint32_t Difference = 0;

volatile uint32_t PWM_IC_Rising_Value_1 = 0;
volatile uint32_t PWM_IC_Rising_Value_2 = 0;
volatile uint32_t PWM_IC_Rising_Value_Diff = 0;

volatile uint32_t PWM_IC_falling_Value_1 = 0;
volatile uint32_t PWM_IC_falling_Value_2 = 0;
volatile uint32_t PWM_IC_falling_Value_Diff = 0;

volatile float duty_cycle = 0.0;
volatile uint32_t Frenquency = 0;
uint8_t Is_duty_cycle = 0;

/* USER CODE END PV */

void SystemClock_Config(void);

/* USER CODE BEGIN 0 */

void HAL_TIM_IC_CaptureCallback(TIM_HandleTypeDef *htim)
{
//	if(htim->Channel == HAL_TIM_ACTIVE_CHANNEL_1)
//	{
//		PWM_IC_falling_Value_2 = HAL_TIM_ReadCapturedValue(htim, TIM_CHANNEL_1);
//
//
//		if(PWM_IC_falling_Value_2 > PWM_IC_falling_Value_1)
//		{
//			PWM_IC_falling_Value_Diff = PWM_IC_falling_Value_2 - PWM_IC_falling_Value_1;
//		}
//		else if(PWM_IC_falling_Value_2 < PWM_IC_falling_Value_1)
//		{
//			PWM_IC_falling_Value_Diff = (0xffff - PWM_IC_falling_Value_1 ) + PWM_IC_falling_Value_2 + 1;
//		}
//		else
//		{
//			Error_Handler();
//		}
//
//		PWM_IC_falling_Value_1 = PWM_IC_falling_Value_2;
//
//		Frenquency = TIM_CLOCKS / PWM_IC_falling_Value_Diff;
//
//		PWM_IC_Rising_Value_1 = HAL_TIM_ReadCapturedValue(htim, TIM_CHANNEL_2);
//	}
//	else if(htim->Channel == HAL_TIM_ACTIVE_CHANNEL_2)
//	{
//		PWM_IC_Rising_Value_2 = HAL_TIM_ReadCapturedValue(htim, TIM_CHANNEL_2);
//		if(PWM_IC_Rising_Value_2 > PWM_IC_Rising_Value_1)
//		{
//			PWM_IC_Rising_Value_Diff = PWM_IC_Rising_Value_2 - PWM_IC_Rising_Value_1;
//		}
//		else if(PWM_IC_Rising_Value_2 < PWM_IC_Rising_Value_1)
//		{
//			PWM_IC_Rising_Value_Diff = (0xffff - PWM_IC_Rising_Value_1 ) + PWM_IC_Rising_Value_2 + 1;
//		}
//		else
//		{
//			Error_Handler();
//		}
//		duty_cycle = PWM_IC_Rising_Value_Diff * 100.0 /  PWM_IC_falling_Value_Diff  ;
//	}
//	PWM_IC_Rising_Value_1 = HAL_TIM_ReadCapturedValue(htim, TIM_CHANNEL_1);
//	PWM_IC_Rising_Value_2 = HAL_TIM_ReadCapturedValue(htim, TIM_CHANNEL_2);
//	PWM_IC_Rising_Value_Diff = PWM_IC_Rising_Value_1 - PWM_IC_Rising_Value_2;

if(htim->Channel == HAL_TIM_ACTIVE_CHANNEL_1)
	IC_Value_1 = HAL_TIM_ReadCapturedValue(htim, TIM_CHANNEL_1);
if(htim->Channel == HAL_TIM_ACTIVE_CHANNEL_2)
	IC_Value_2 = HAL_TIM_ReadCapturedValue(htim, TIM_CHANNEL_2);

}

/* USER CODE END 0 */

int main(void)
{

  /* MCU Configuration--------------------------------------------------------*/

  /* Reset of all peripherals, Initializes the Flash interface and the Systick. */
  HAL_Init();

  /* Configure the system clock */
  SystemClock_Config();

  /* Initialize all configured peripherals */
  MX_GPIO_Init();
  MX_TIM4_Init();
  /* USER CODE BEGIN 2 */
  printf("Start\r\n");

  HAL_TIM_IC_Start_IT(&htim4,TIM_CHANNEL_1);
  HAL_TIM_IC_Start_IT(&htim4,TIM_CHANNEL_2);
  /* USER CODE END 2 */

  /* Infinite loop */
  while(1)
  {
	if (IC_Value_1 == 0)
	{
		duty_cycle = 0;
		Frenquency = 0;
	}
	else
	{
		duty_cycle = IC_Value_2 * 100 / IC_Value_1;
		Frenquency = 90000000 / IC_Value_1;
	}

  }
}

void SystemClock_Config(void)
{
  RCC_OscInitTypeDef RCC_OscInitStruct = {0};
  RCC_ClkInitTypeDef RCC_ClkInitStruct = {0};

  /** Configure the main internal regulator output voltage
  */
  __HAL_RCC_PWR_CLK_ENABLE();
  __HAL_PWR_VOLTAGESCALING_CONFIG(PWR_REGULATOR_VOLTAGE_SCALE1);
  /** Initializes the CPU, AHB and APB busses clocks
  */
  RCC_OscInitStruct.OscillatorType = RCC_OSCILLATORTYPE_HSE;
  RCC_OscInitStruct.HSEState = RCC_HSE_ON;
  RCC_OscInitStruct.PLL.PLLState = RCC_PLL_ON;
  RCC_OscInitStruct.PLL.PLLSource = RCC_PLLSOURCE_HSE;
  RCC_OscInitStruct.PLL.PLLM = 15;
  RCC_OscInitStruct.PLL.PLLN = 216;
  RCC_OscInitStruct.PLL.PLLP = RCC_PLLP_DIV2;
  RCC_OscInitStruct.PLL.PLLQ = 4;
  if (HAL_RCC_OscConfig(&RCC_OscInitStruct) != HAL_OK)
  {
    Error_Handler();
  }
  /** Activate the Over-Drive mode
  */
  if (HAL_PWREx_EnableOverDrive() != HAL_OK)
  {
    Error_Handler();
  }
  /** Initializes the CPU, AHB and APB busses clocks
  */
  RCC_ClkInitStruct.ClockType = RCC_CLOCKTYPE_HCLK|RCC_CLOCKTYPE_SYSCLK
                              |RCC_CLOCKTYPE_PCLK1|RCC_CLOCKTYPE_PCLK2;
  RCC_ClkInitStruct.SYSCLKSource = RCC_SYSCLKSOURCE_PLLCLK;
  RCC_ClkInitStruct.AHBCLKDivider = RCC_SYSCLK_DIV1;
  RCC_ClkInitStruct.APB1CLKDivider = RCC_HCLK_DIV4;
  RCC_ClkInitStruct.APB2CLKDivider = RCC_HCLK_DIV2;

  if (HAL_RCC_ClockConfig(&RCC_ClkInitStruct, FLASH_LATENCY_5) != HAL_OK)
  {
    Error_Handler();
  }
}

/* USER CODE BEGIN 4 */

int _write(int file, char *ptr, int len) {
	int DataIdx;
	for (DataIdx = 0; DataIdx < len; DataIdx++) {
		ITM_SendChar(*ptr++);
	}
	return len;
}

/* USER CODE END 4 */

void Error_Handler(void)
{
  /* USER CODE BEGIN Error_Handler_Debug */
  /* User can add his own implementation to report the HAL error return state */
	while(1);
  /* USER CODE END Error_Handler_Debug */
}

/************************ (C) COPYRIGHT STMicroelectronics *****END OF FILE****/
